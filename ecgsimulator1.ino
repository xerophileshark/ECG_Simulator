/*
 * File name: ecg.ino
 * Tested on Arduino Due on Monday, October 28, 2019, 13:22'
 * By: Ali Abedi, aliabediemail@yahoo.com
 * Notes:
 *  1. First and last element of the dara array should be zero(0).
 *  2. Maximum HR that can be produced by this samples is 80 BPM. (751 point = 0.75 sec in 1000 Hz sampling rate)
 *  3. The sampling frequency is set to 1000 Hz using TC1 interrupt.
 *  
*/

#include <math.h>

#define SAMPLE_FREQ 1000 //Hz

double HRdata[751] = {0.0002,
                      0.0009,
                      0.0016,
                      0.0022,
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                      0.0004,
                      0
                     };

volatile int i;
volatile double delta_t;
volatile int HR; // HeartRate (BPM)
volatile bool outputflag;
volatile bool noiseflag;
volatile int state;
volatile int Delay;

//Timer Interrupt Service: TC1 ch 0:
void TC3_Handler()
{
  TC_GetStatus(TC1, 0); // ???
  if (outputflag) {
    if (state == 1) {
      double output = HRdata[i] + 0.4900; //min(HRdata = -0.4900)
      i++;
      if (i == 751) {
        i = 0;
        state++;
      }
      long randNumber = random(500); // About 0.2655 volts
      analogWrite(DAC0, (int)(((noiseflag == true) ? randNumber : 0.0) + output * 1884.1447));
    } else if (state == 2) {
      double delta_t = 60.00 / (double)HR;
      Delay = (int)(1000 * (delta_t - 0.750)); //750 is minimum Delay available for this set of data "HRdata".
      if (Delay < 0) {
        Delay = 0;
      }
      Serial.println(Delay);
      i++;
      if (i >= Delay) {
        i = 0;
        state--;
      }
    } else {
      state = 1;
    }
  }
}

void startTimer(Tc *tc, uint32_t channel, IRQn_Type irq, uint32_t frequency) {
  pmc_set_writeprotect(false);
  pmc_enable_periph_clk((uint32_t)irq);
  TC_Configure(tc, channel, TC_CMR_WAVE | TC_CMR_WAVSEL_UP_RC | TC_CMR_TCCLKS_TIMER_CLOCK4);
  uint32_t rc = VARIANT_MCK / 128 / frequency; //128 because we selected TIMER_CLOCK4 above
  TC_SetRA(tc, channel, rc / 2); //50% high, 50% low
  TC_SetRC(tc, channel, rc);
  TC_Start(tc, channel);
  tc->TC_CHANNEL[channel].TC_IER = TC_IER_CPCS;
  tc->TC_CHANNEL[channel].TC_IDR = ~TC_IER_CPCS;
  NVIC_EnableIRQ(irq);
}

void setup() {
  analogWriteResolution(12); // The default resolution is 8 bit.

  // Initialize variables:
  delta_t = 1.0 / SAMPLE_FREQ;
  HR = 0;
  outputflag = false;
  Delay = 0;
  state = 1;

  // Start timer interrupt service:
  startTimer(TC1, 0, TC3_IRQn, SAMPLE_FREQ); //TC1 channel 0, the IRQ for that channel and the desired frequency (=1000HZ)

  //Random seed
  randomSeed(analogRead(A0));

  // Initialize Serial Interface:
  Serial.begin(115200);
}//end setup

void loop() {
  if (outputflag == false) {
    while (true) {
      if (Serial.available()) {
        HR = Serial.readString().toInt();
        Serial.println(""); Serial.print("[OK] "); Serial.print(HR); Serial.println(" is selected as HR.");
        Serial.println("Do you want noise?");
        while (!Serial.available()) {}
        String d = Serial.readString();
        if (d.indexOf("y") >= 0) {
          noiseflag = true;
          Serial.println("[OK] Noise generation: True!");
        } else {
          noiseflag = false;
          Serial.println("[OK] Noise generation: False!");
        }
        outputflag = true;
        Serial.println("[OK] Signal generation started!");
        break;
      } else {
        Serial.println(".");
        delay(100);
      }
    }
  }
}
